## boards/LignaEnergy/E-Luchigna/Kconfig.E-Luchigna
```kconfig
config BOARD_E-LUCHIGNA
	bool "Custom board for E-LUCHIGNA"
	select SOC_NRF52832_QFAA
```

## boards/arm/Gwen/Kconfig.board
```kconfig
config BOARD_GWEN
	bool "Custom Board auto generated by nRF Connect for VS Code"
	depends on SOC_NRF52832_QFAA
```

## boards/arm/Gwen/Kconfig.defconfig
```kconfig
if BOARD_GWEN

config BOARD
	default "Gwen"

config BT_CTLR
	default BT

config BOARD_ENABLE_DCDC
	bool "Enable DCDC mode"
	select SOC_DCDC_NRF52X
	default y
	
endif # BOARD_GWEN
```

## boards/arm/eluchigna/Kconfig.board
```kconfig
config BOARD_ELUCHIGNA
	bool "Custom Board auto generated by nRF Connect for VS Code"
	depends on SOC_NRF52832_QFAA
```

## boards/arm/eluchigna/Kconfig.defconfig
```kconfig
if BOARD_ELUCHIGNA

config BOARD
	default "eluchigna"

config BT_CTLR
	default BT

endif # BOARD_ELUCHIGNA
```

## boards/arm/eluchigna/eluchigna_defconfig
```kconfig
CONFIG_SOC_SERIES_NRF52X=y
CONFIG_SOC_NRF52832_QFAA=y
CONFIG_BOARD_ELUCHIGNA=y

CONFIG_ARM_MPU=y
CONFIG_HW_STACK_PROTECTION=y

CONFIG_PINCTRL=y
```

## boards/arm/jiva/Kconfig.board
```kconfig
# Copyright (c) 2024 Nordic Semiconductor ASA
# SPDX-License-Identifier: Apache-2.0

config BOARD_JIVA
	bool "jiva"
	depends on SOC_NRF52832_QFAA
```

## boards/arm/jiva/Kconfig.defconfig
```kconfig
# Copyright (c) 2024 Nordic Semiconductor ASA
# SPDX-License-Identifier: Apache-2.0

if BOARD_JIVA

config BOARD
	default "jiva"

config BT_CTLR
   default BT

config BOARD_ENABLE_DCDC
	bool "Enable DCDC mode"
	select SOC_DCDC_NRF52X
	default y
   
endif
```
